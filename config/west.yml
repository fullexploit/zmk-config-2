## config/west.yml
```yaml
manifest:
  defaults:
    revision: v0.3
  remotes:
    - name: fullexploit
      url-base: https://github.com/fullexploit
  projects:
    - name: zmk
      remote: fullexploit
      import: app/west.yml
    - name: zmk-locales
      remote: fullexploit
      revision: main
  self:
    path: config
```
